## Kconfig
```kconfig
mainmenu "OpenWCH SDK Configuration"

menu "Build artifacts"

config OPENWCH_GEN_HEX
    bool "Generate .hex output"
    default y

config OPENWCH_GEN_BIN
    bool "Generate .bin output"
    default y

config OPENWCH_GEN_MAP
    bool "Generate .map output"
    default y

config OPENWCH_GEN_DEBUG_FILES
    bool "Generate debug files (.lst/.relf/.symb)"
    default y

endmenu

source "components/Kconfig"
```

## components/Kconfig
```kconfig
choice SOC_CHOICE
    prompt "Target SoC"
    default SOC_CH58X

config SOC_CH58X
    bool "CH58x"

config SOC_CH59X
    bool "CH59x"

endchoice

choice BOARD_CHOICE
    prompt "Target Board"
    default BOARD_CH58X_EVB

config BOARD_CH58X_EVB
    bool "CH58x EVB"
    depends on SOC_CH58X

config BOARD_CH59X_EVB
    bool "CH59x EVB"
    depends on SOC_CH59X

config BOARD_CUSTOM
    bool "Custom board (defined by project)"
    depends on SOC_CH58X || SOC_CH59X

endchoice

rsource "soc_ch58x/Kconfig"
rsource "soc_ch59x/Kconfig"

menu "Component Configuration"

rsource "wch_log/Kconfig"
rsource "rtos/Kconfig"

endmenu
```

## components/rtos/Kconfig
```kconfig
menu "RTOS"

config FREERTOS_ENABLE
    bool "Enable FreeRTOS"
    default n

if FREERTOS_ENABLE
config FREERTOS_TICK_RATE_HZ
    int "FreeRTOS tick rate (Hz)"
    default 100
    range 10 1000

config FREERTOS_HEAP_IMPL
    int "FreeRTOS heap implementation (1..5)"
    default 4
    range 1 5
endif

config RTTHREAD_ENABLE
    bool "Enable RT-Thread"

config LITEOS_M_ENABLE
    bool "Enable LiteOS_M"

endmenu
```

## components/soc_ch58x/Kconfig
```kconfig
menu "SoC Configuration"
    depends on SOC_CH58X

menu "CH58x SoC drivers"

    config SOC_CH58X_UART
        bool "Enable CH58x UART driver"
        default y
        depends on SOC_CH58X

    config SOC_CH58X_GPIO
        bool "Enable CH58x GPIO driver"
        default y
        depends on SOC_CH58X

    config SOC_CH58X_SPI
        bool "Enable CH58x SPI driver"
        default n
        depends on SOC_CH58X

    config SOC_CH58X_I2C
        bool "Enable CH58x I2C driver"
        default n
        depends on SOC_CH58X

    config SOC_CH58X_TIMER
        bool "Enable CH58x TIMER driver"
        default y
        depends on SOC_CH58X

    config SOC_CH58X_ADC
        bool "Enable CH58x ADC driver"
        default y
        depends on SOC_CH58X

    config SOC_CH58X_WDT
        bool "Enable CH58x WDT driver"
        default n
        depends on SOC_CH58X
    
    config SOC_CH58X_PWM
        bool "Enable CH58x PWM driver"
        default n
        depends on SOC_CH58X

    config SOC_CH58X_USB
        bool "Enable CH58x USB driver"
        default n
        depends on SOC_CH58X

endmenu

menu "Flash and SRAM Configuration"

    config CH58X_FLASH_SIZE_KB
        int "Flash Size (KB)"
        default 448
        help
          Set the size of the flash memory in kilobytes.

    config CH58X_RAM_SIZE_KB
        int "CH58x RAM size (KB)"
        default 128
        range 96 128
        help
          Set the size of the RAM memory in kilobytes.

endmenu

rsource "libble/Kconfig"

menu "Debug Configuration"

choice DEBUG_INTERFACE
    prompt "Debug Interface"
    default DEBUG_UART0
    help
      Select debug output interface

config DEBUG_NONE
    bool "No Debug Output"

config DEBUG_UART0
    bool "UART0 Debug Output"

config DEBUG_UART1
    bool "UART1 Debug Output"

endchoice

config DEBUG_UART_PORT
    int
    default 0 if DEBUG_NONE
    default 1 if DEBUG_UART0
    default 2 if DEBUG_UART1
    help
      Debug UART port number (0=none, 1=UART0, 2=UART1)

endmenu

endmenu
```

## components/soc_ch59x/Kconfig
```kconfig
menu "SoC Configuration"
    depends on SOC_CH59X

menu "CH59X SoC drivers"

    config SOC_CH59X_UART
        bool "Enable CH59X UART driver"
        default y
        depends on SOC_CH59X

    config SOC_CH59X_GPIO
        bool "Enable CH59X GPIO driver"
        default y
        depends on SOC_CH59X

    config SOC_CH59X_SPI
        bool "Enable CH59X SPI driver"
        default n
        depends on SOC_CH59X

    config SOC_CH59X_I2C
        bool "Enable CH59X I2C driver"
        default n
        depends on SOC_CH59X

    config SOC_CH59X_TIMER
        bool "Enable CH59X TIMER driver"
        default n
        depends on SOC_CH59X

    config SOC_CH59X_ADC
        bool "Enable CH59X ADC driver"
        default n
        depends on SOC_CH59X

    config SOC_CH59X_WDT
        bool "Enable CH59X WDT driver"
        default n
        depends on SOC_CH59X
    
    config SOC_CH59X_PWM
        bool "Enable CH59X PWM driver"
        default n
        depends on SOC_CH59X

    config SOC_CH59X_USB
        bool "Enable CH59X USB driver"
        default n
        depends on SOC_CH59X

endmenu

rsource "libble/Kconfig"

menu "Debug Configuration"

choice DEBUG_INTERFACE
    prompt "Debug Interface"
    default DEBUG_UART0
    help
      Select debug output interface

config DEBUG_NONE
    bool "No Debug Output"

config DEBUG_UART0
    bool "UART0 Debug Output"

config DEBUG_UART1
    bool "UART1 Debug Output"

endchoice

config DEBUG_UART_PORT
    int
    default 0 if DEBUG_NONE
    default 1 if DEBUG_UART0
    default 2 if DEBUG_UART1
    help
      Debug UART port number (0=none, 1=UART0, 2=UART1)

endmenu

endmenu
```

## components/soc_ch59x/libble/Kconfig
```kconfig
config BLE_SUPPORT
    bool "Enable BLE (Bluetooth Low Energy) support"
    default n
    help
        Enable Bluetooth Low Energy support for CH58x series.

if BLE_SUPPORT

config BLE_PERIPHERAL_ONLY
    bool "Use peripheral-only BLE library"
    default n
    help
        Use the smaller peripheral-only BLE library (libCH58xBLE_PERI.a)
        instead of the full BLE library (libCH58xBLE.a).
        This reduces code size if only peripheral role is needed.

menu "BLE MAC Address"

config BLE_MAC
    bool "Use custom MAC address"
    default n
    help
        Use custom Bluetooth MAC address instead of chip default MAC.
        You need to define MacAddr[] in your application code.

endmenu

menu "Power Management"

config DCDC_ENABLE
    bool "Enable DC-DC converter"
    default n
    help
        Enable the DC-DC power converter for better power efficiency.

config HAL_SLEEP
    bool "Enable sleep mode"
    default n
    help
        Enable sleep functionality to reduce power consumption.

if HAL_SLEEP

config SLEEP_RTC_MIN_TIME
    int "Minimum sleep time (RTC ticks)"
    default 1000
    help
        Minimum sleep time in RTC ticks for non-idle sleep mode.

config SLEEP_RTC_MAX_TIME
    int "Maximum sleep time (RTC ticks)"
    default 30000000
    help
        Maximum sleep time in RTC ticks for non-idle sleep mode.

config WAKE_UP_RTC_MAX_TIME
    int "Wake-up stabilization time (RTC ticks)"
    default 1600
    help
        Time to wait for 32MHz crystal stabilization after wake-up.
        Sleep/Power-down mode: 45, Pause mode: 45, Idle mode: 5

endif # HAL_SLEEP

endmenu

menu "BLE Calibration"

config TEM_SAMPLE
    bool "Enable temperature calibration"
    default y
    help
        Enable calibration based on temperature changes.
        Single calibration takes less than 10ms.

config BLE_CALIBRATION_ENABLE
    bool "Enable periodic calibration"
    default y
    help
        Enable periodic BLE calibration.
        Single calibration takes less than 10ms.

config BLE_CALIBRATION_PERIOD
    int "Calibration period (ms)"
    default 120000
    depends on BLE_CALIBRATION_ENABLE
    help
        Period between automatic calibrations in milliseconds.

endmenu

menu "BLE SNV (Simple NV Storage)"

config BLE_SNV
    bool "Enable SNV for bonding info"
    default y
    help
        Enable Simple NV Storage for storing bonding information.

config BLE_SNV_ADDR
    hex "SNV storage address"
    default 0x77000
    depends on BLE_SNV
    help
        Flash address for SNV storage (will subtract FLASH_ROM_MAX_SIZE).

config BLE_SNV_BLOCK
    int "SNV block size"
    default 256
    depends on BLE_SNV
    help
        Size of each SNV block in bytes.

config BLE_SNV_NUM
    int "Number of SNV blocks"
    default 1
    depends on BLE_SNV
    help
        Number of SNV blocks to allocate.

endmenu

menu "Clock Configuration"

choice CLK_OSC32K
    prompt "RTC clock source"
    default CLK_OSC32K_INTERNAL_32000
    help
        Select RTC clock source. External 32K must be used for central role.

config CLK_OSC32K_EXTERNAL
    bool "External 32.768 KHz crystal"

config CLK_OSC32K_INTERNAL_32000
    bool "Internal 32.000 KHz RC"

config CLK_OSC32K_INTERNAL_32768
    bool "Internal 32.768 KHz RC"

endchoice

config CLK_OSC32K
    int
    default 0 if CLK_OSC32K_EXTERNAL
    default 1 if CLK_OSC32K_INTERNAL_32000
    default 2 if CLK_OSC32K_INTERNAL_32768

endmenu

menu "BLE Memory Configuration"

config BLE_MEMHEAP_SIZE
    int "BLE stack heap size (bytes)"
    default 6144
    help
        RAM size used by BLE protocol stack, minimum 6KB.

config BLE_BUFF_MAX_LEN
    int "Maximum packet length"
    default 27
    range 27 516
    help
        Maximum packet length for a single connection.
        Default 27 bytes (ATT_MTU=23).

config BLE_BUFF_NUM
    int "Buffer packet count"
    default 5
    help
        Number of packets buffered by the controller.

config BLE_TX_NUM_EVENT
    int "Max TX packets per connection event"
    default 1
    help
        Maximum number of packets that can be sent in a single connection event.

endmenu

menu "BLE Radio Configuration"

choice BLE_TX_POWER
    prompt "TX power level"
    default BLE_TX_POWER_0_DBM
    help
        BLE transmission power level.

config BLE_TX_POWER_N12_DBM
    bool "-12 dBm"

config BLE_TX_POWER_N9_DBM
    bool "-9 dBm"

config BLE_TX_POWER_N6_DBM
    bool "-6 dBm"

config BLE_TX_POWER_N3_DBM
    bool "-3 dBm"

config BLE_TX_POWER_0_DBM
    bool "0 dBm"

config BLE_TX_POWER_3_DBM
    bool "+3 dBm"

config BLE_TX_POWER_6_DBM
    bool "+6 dBm"

endchoice

config BLE_TX_POWER
    int
    default 0 if BLE_TX_POWER_N12_DBM
    default 1 if BLE_TX_POWER_N9_DBM
    default 2 if BLE_TX_POWER_N6_DBM
    default 3 if BLE_TX_POWER_N3_DBM
    default 4 if BLE_TX_POWER_0_DBM
    default 5 if BLE_TX_POWER_3_DBM
    default 6 if BLE_TX_POWER_6_DBM

endmenu

menu "BLE Multi-Connection"

config PERIPHERAL_MAX_CONNECTION
    int "Maximum peripheral connections"
    default 1
    range 0 4
    help
        Maximum number of simultaneous peripheral (slave) role connections.

config CENTRAL_MAX_CONNECTION
    int "Maximum central connections"
    default 3
    range 0 4
    help
        Maximum number of simultaneous central (master) role connections.

endmenu

menu "HAL Features"

config HAL_KEY
    bool "Enable key (button) support"
    default n
    help
        Enable HAL support for hardware keys/buttons.

config HAL_LED
    bool "Enable LED support"
    default n
    help
        Enable HAL support for LEDs.

endmenu

endif # BLE_SUPPORT
```

## components/wch_log/Kconfig
```kconfig
menu "WCH Log"

config WCH_LOG_UART
    bool "Enable UART log output"
    default y

config WCH_LOG_RTT
    bool "Enable RTT log output"
    default n

config WCH_LOG_CDC
    bool "Enable USB CDC log output"
    default n

config WCH_LOG_COLORS
    bool "Enable ANSI log colors"
    default y

choice WCH_LOG_LEVEL_CHOICE
    prompt "Log level"
    default WCH_LOG_LEVEL_DEBUG
    help
      Select log level

config WCH_LOG_LEVEL_NONE
    bool "None"

config WCH_LOG_LEVEL_ERROR
    bool "Error"

config WCH_LOG_LEVEL_WARN
    bool "Warn"

config WCH_LOG_LEVEL_INFO
    bool "Info"

config WCH_LOG_LEVEL_DEBUG
    bool "Debug"

config WCH_LOG_LEVEL_VERBOSE
    bool "Verbose"

endchoice

endmenu
```

## examples/bluetooth/ble/peripheral/kconfig
```kconfig
menu "Custom Board Options"

config CUSTOM_BOARD_HAS_RF_PA
	bool "Custom board has RF PA"
	default n

endmenu
```

## examples/get_started/custom_board/kconfig
```kconfig
menu "Custom Board Options"

config CUSTOM_BOARD_HAS_LED
	bool "Custom board has LED"
	default y

config CUSTOM_BOARD_HAS_KEY
	bool "Custom board has key"
	default y

endmenu
```
